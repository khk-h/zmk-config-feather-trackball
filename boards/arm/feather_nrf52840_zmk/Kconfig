## boards/arm/feather_nrf52840_zmk/Kconfig.board
```kconfig
# Adafruit Feather nRF52840 Express（ZMK 用の定義）
# SPDX-License-Identifier: MIT

config BOARD_FEATHER_NRF52840_ZMK
    bool "Adafruit Feather nRF52840 Express (ZMK)"
    depends on SOC_NRF52840_QIAA
```

## boards/arm/feather_nrf52840_zmk/Kconfig.defconfig
```kconfig
# SPDX-License-Identifier: MIT

if BOARD_FEATHER_NRF52840_ZMK

config BOARD
    default "feather_nrf52840_zmk"

if USB_DEVICE_STACK

config USB_NRFX
    default y

endif # USB_DEVICE_STACK

config BT_CTLR
    default BT

endif # BOARD_FEATHER_NRF52840_ZMK
```

## boards/arm/feather_nrf52840_zmk/feather_nrf52840_zmk_defconfig
```kconfig
# SPDX-License-Identifier: MIT
# ZMK v0.3.0 の nice!nano v2 の定義と同じ内容（どちらも nRF52840 ＋ Adafruit の UF2 ブートローダ）

CONFIG_SOC_SERIES_NRF52X=y
CONFIG_SOC_NRF52840_QIAA=y
CONFIG_BOARD_FEATHER_NRF52840_ZMK=y

CONFIG_ARM_MPU=y
CONFIG_PINCTRL=y
CONFIG_GPIO=y

# UF2 ブートローダの配置に合わせてファームウェアを置き、.uf2 形式で出力する
CONFIG_USE_DT_CODE_PARTITION=y
CONFIG_BUILD_OUTPUT_UF2=y

# ペアリング情報などをフラッシュに保存する
CONFIG_MPU_ALLOW_FLASH_WRITE=y
CONFIG_NVS=y
CONFIG_SETTINGS_NVS=y
CONFIG_FLASH=y
CONFIG_FLASH_PAGE_LAYOUT=y
CONFIG_FLASH_MAP=y

CONFIG_ZMK_BLE=y
CONFIG_ZMK_USB=y
```

## boards/shields/trackball_test/Kconfig.defconfig
```kconfig
if SHIELD_TRACKBALL_TEST

    # Bluetooth で見える名前（16文字まで）
    config ZMK_KEYBOARD_NAME
        default "TB Test"

    config INPUT
        bool
        default y

    config PMW3610
        bool
        default y

    config SPI
        bool
        default y

    config ZMK_POINTING
        bool
        default y

endif
```

## boards/shields/trackball_test_paw3222/Kconfig.defconfig
```kconfig
if SHIELD_TRACKBALL_TEST_PAW3222

    # Bluetooth で見える名前（16文字まで）
    config ZMK_KEYBOARD_NAME
        default "TB PAW Test"

    config INPUT
        bool
        default y

    config PAW3222
        bool
        default y

    config SPI
        bool
        default y

    config ZMK_POINTING
        bool
        default y

endif
```

## boards/shields/trackball_test_split/Kconfig.defconfig
```kconfig
# 右＝セントラル（パソコンとつながる側、トラックボール付き）、左＝ペリフェラル

if SHIELD_TRACKBALL_TEST_SPLIT_RIGHT

    # Bluetooth で見える名前（16文字まで）
    config ZMK_KEYBOARD_NAME
        default "TB Split Test"

    config ZMK_SPLIT_ROLE_CENTRAL
        default y

    config INPUT
        bool
        default y

    config PMW3610
        bool
        default y

    config SPI
        bool
        default y

endif

# 右を PAW3222 にした版（左は trackball_test_split_left のまま）
if SHIELD_TRACKBALL_TEST_SPLIT_RIGHT_PAW3222

    # Bluetooth で見える名前（16文字まで）
    config ZMK_KEYBOARD_NAME
        default "TB Split PAW"

    config ZMK_SPLIT_ROLE_CENTRAL
        default y

    config INPUT
        bool
        default y

    config PAW3222
        bool
        default y

    config SPI
        bool
        default y

endif

if SHIELD_TRACKBALL_TEST_SPLIT_LEFT || SHIELD_TRACKBALL_TEST_SPLIT_RIGHT || SHIELD_TRACKBALL_TEST_SPLIT_RIGHT_PAW3222

    config ZMK_SPLIT
        default y

    # キーマップにマウスのボタン（&mkp）があるので、左右とも有効にする
    config ZMK_POINTING
        bool
        default y

endif
```
